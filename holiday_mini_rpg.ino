/*

*/
#include <Wire.h>
#include <hd44780.h>                       // main hd44780 header
#include <hd44780ioClass/hd44780_I2Cexp.h> // i2c expander i/o class header

hd44780_I2Cexp lcd; // declare lcd object: auto locate & auto config expander chip

#define UP 34
#define DOWN 32 
#define LEFT 30
#define RIGHT 36
#define X 5

const int LCD_COLS = 20;
const int LCD_ROWS = 4;

uint8_t gift[8] = {0x00, 0x0a, 0x04, 0x1f, 0x15, 0x15, 0x15, 0x1f};
uint8_t elfie[8] = {0x1b, 0x04, 0x0e, 0x15, 0x1f, 0x0e, 0x0e, 0x1b};

int playerX = 0;
int playerY = 0;
int shortDelay = 150;
int mvmt = 1;

void setup()
{
  pinMode(UP, INPUT);
  pinMode(DOWN, INPUT);
  pinMode(LEFT, INPUT);
  pinMode(RIGHT, INPUT);
  int status;
	status = lcd.begin(LCD_COLS, LCD_ROWS);
	if(status) // non zero status means it was unsuccesful
	{
		// begin() failed so blink error code using the onboard LED if possible
		hd44780::fatalError(status); // does not return
	}
	
	lcd.createChar(0, gift);
	lcd.createChar(1, elfie);
}

void loop() {
  digitalWrite(UP, HIGH);
  digitalWrite(DOWN, HIGH);
  digitalWrite(LEFT, HIGH);
  digitalWrite(RIGHT, HIGH);
  
  lcd.clear();
  lcd.setCursor(13, 6);
  lcd.print('\000');
  
  lcd.setCursor(playerX, playerY);
  lcd.print('\001');
  
  if (digitalRead(UP) == LOW) {
    if(playerY >= 1){
      playerY-=mvmt;
    }
  } 
  if (digitalRead(DOWN) == LOW) {
    if(playerY <= 3){
      playerY+=mvmt;
    }
  } 
  if (digitalRead(LEFT) == LOW) {
    if(playerX >= 1){
      playerX-=mvmt;
    }
  } 
  if (digitalRead(RIGHT) == LOW) {
    if(playerX <= 19){
      playerX+=mvmt;
    }
    
  } 
  
  delay(shortDelay);
}
